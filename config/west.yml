## config/west.yml
```yaml
manifest:
  remotes:
    - name: zmkfirmware
      url-base: https://github.com/zmkfirmware
    - name: andrewjrae
      url-base: https://github.com/andrewjrae
  projects:
    - name: zmk
      remote: andrewjrae
      revision: v3.0.0+zmk-fixes
      import: app/west.yml
  self:
    path: config
```
